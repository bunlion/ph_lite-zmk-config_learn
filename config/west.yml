## config/west.yml
```yaml
manifest:
  defaults:
    revision: v0.3
  remotes:
    - name: zmkfirmware
      url-base: https://github.com/zmkfirmware/
    - name: phdesign
      url-base: https://github.com/ph-design/
    # Additional modules containing boards/shields/custom code can be listed here as well
    # See https://docs.zephyrproject.org/3.2.0/develop/west/manifest.html#projects
  projects:
    - name: zmk
      remote: phdesign
      revision: v0.3-lts
      import: app/west.yml
    - name: ph_lite-zmk-config_learn
      url: https://github.com/bunlion/ph_lite-zmk-config_learn
      revision: master
      path: modules/ph_lite-zmk-config_learn
  self:
    path: config
```
